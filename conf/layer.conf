## conf/layer.conf
```bitbake
# We have a conf and classes directory, add to BBPATH
BBPATH .= ":${LAYERDIR}"

# We have recipes-* directories, add to BBFILES
BBFILES += "${LAYERDIR}/recipes-*/*/*.bb \
            ${LAYERDIR}/recipes-*/*/*.bbappend"

BBFILE_COLLECTIONS += "meta-blinkos"
BBFILE_PATTERN_meta-blinkos = "^${LAYERDIR}/"
BBFILE_PRIORITY_meta-blinkos = "6"

LAYERDEPENDS_meta-blinkos = "core"
LAYERSERIES_COMPAT_meta-blinkos = "scarthgap"

LAYERDIR_BLINKOS = "${LAYERDIR}"
```
